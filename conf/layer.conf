## conf/layer.conf
```bitbake
# We have a conf and classes directory, add to BBPATH
BBPATH .= ":${LAYERDIR}"

# We have recipes-* directories, add to BBFILES
BBFILES += "${LAYERDIR}/recipes-*/*/*.bb \
            ${LAYERDIR}/recipes-*/*/*.bbappend"

BBFILE_COLLECTIONS += "tgamblin-kernel"
BBFILE_PATTERN_tgamblin-kernel = "^${LAYERDIR}/"
BBFILE_PRIORITY_tgamblin-kernel = "5"
```
